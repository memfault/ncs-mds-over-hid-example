## app/boards/nrf52840dk_nrf52840.conf
```kconfig
# nRF52840 DK board-specific configuration
CONFIG_MEMFAULT_NCS_HW_VERSION="nrf52840dk"
```

## app/boards/nrf5340dk_nrf5340_cpuapp.conf
```kconfig
# nRF5340 DK board-specific configuration
CONFIG_MEMFAULT_NCS_HW_VERSION="nrf5340dk"
```

## app/boards/nrf54lm20dk_nrf54lm20a_cpuapp.conf
```kconfig
# nRF54LM20 DK board-specific configuration
CONFIG_MEMFAULT_NCS_HW_VERSION="nrf54lm20dk"
```

## app/west.yml
```yaml
manifest:
  self:
    path: app

  remotes:
    - name: ncs
      url-base: git@github.com:nrfconnect

  projects:
    - name: sdk-nrf
      remote: ncs
      path: nrf
      revision: v3.2.1
      import: true
```
